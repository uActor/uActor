## components/testbed/Kconfig.projbuild
```kconfig
menu "Testbed Configuration"
    config TESTBED_NETWORK_UTILS
        bool "Testbed Network Utils"
        default y
        help
          Enable loggers for values related to networking.
    config TESTBED_NESTED_TIMEKEEPING
      bool "Testbed Nested Timekeeping"
      default n
      help
        Enable nested timekeeping. This enabled the stop_timekeeping_inner method and required the normal stop_timekeeping method to flush the queued inner values.
endmenu
```

## evaluation/microbenchmarks/sdkconfig.defaults.ble
```kconfig
# Enable benchmark logging
CONFIG_BENCHMARK_ENABLED=y

# GCC -O2 mode
CONFIG_COMPILER_OPTIMIZATION_PERF=y

# 240 Mhz & 1000 HZ Tickrate
CONFIG_FREERTOS_HZ=1000
CONFIG_ESP32_DEFAULT_CPU_FREQ_240=y
CONFIG_ESP32_DEFAULT_CPU_FREQ_MHZ=240
CONFIG_ESPTOOLPY_FLASHSIZE_4MB=y
CONFIG_ESPTOOLPY_FLASHSIZE="4MB"

# Enable BLE actor & disable Wi-Fi power saving
CONFIG_BT_ENABLED=y
CONFIG_BTDM_CTRL_MODE_BLE_ONLY=y
CONFIG_BT_NIMBLE_ENABLED=y
CONFIG_ENABLE_BLE_ACTOR=y
CONFIG_DISABLE_WIFI_PS=n

CONFIG_LWIP_USE_ONLY_LWIP_SELECT=y
# Used for some legacy experiments, can most likely be removed
CONFIG_LWIP_MAX_ACTIVE_TCP=16
CONFIG_LWIP_MAX_LISTENING_TCP=16

CONFIG_PARTITION_TABLE_CUSTOM=y
CONFIG_PARTITION_TABLE_CUSTOM_FILENAME="partitions.csv"
CONFIG_PARTITION_TABLE_FILENAME="partitions.csv"
CONFIG_PARTITION_TABLE_OFFSET=0x8000
CONFIG_PARTITION_TABLE_MD5=y

# Enable Exceptions (msgpack-c requires exceptions)
CONFIG_COMPILER_CXX_EXCEPTIONS=y
CONFIG_COMPILER_CXX_EXCEPTIONS_EMG_POOL_SIZE=0

# WiFi Default Settings
CONFIG_ESP32_WIFI_STATIC_RX_BUFFER_NUM=10
CONFIG_ESP32_WIFI_DYNAMIC_RX_BUFFER_NUM=32
CONFIG_ESP32_WIFI_DYNAMIC_TX_BUFFER_NUM=32
CONFIG_ESP32_WIFI_IRAM_OPT=y
CONFIG_ESP32_WIFI_RX_IRAM_OPT=y

# disable platform actors, heap tracking, and telemetry
CONFIG_ENABLE_I2C=n
CONFIG_ENABLE_EPAPER_DISPLAY=n
CONFIG_ENABLE_GPIO_ACTOR=n
CONFIG_UACTOR_ENABLE_HEAP_TRACKING=n
CONFIG_UACTOR_ENABLE_TELEMETRY=n

# Disable watchdogs (required to evaluate the throughput)
CONFIG_ESP_TASK_WDT_CHECK_IDLE_TASK_CPU0=n
CONFIG_ESP_TASK_WDT_CHECK_IDLE_TASK_CPU1=n

# Wi-Fi:
CONFIG_WIFI_SSID="CHANGEME"
CONFIG_WIFI_USE_EDUROAM=n
CONFIG_WIFI_USERNAME=""
CONFIG_WIFI_PASSWORD="CHANGEME"
CONFIG_WIFI_NTP_SERVER="192.168.50.3"
```

## main/Kconfig.projbuild
```kconfig
menu "Wifi Configuration"
    config WIFI_SSID
        string "WiFi SSID"
        default "eduroam"
        help
            SSID
    config WIFI_USE_EDUROAM
        bool "Use eduroam"
        default y
        help
            Use eduroam instead pf WPA personal.
            Uses username + password,
            validatates server using the key in binary folder.
            SSID needs to be set to eduroam.

    config WIFI_USERNAME
        string "Eduroam username"
        default "foobar"
        help
            WiFi WPA enterprise username used in eduroam mode.

    config WIFI_PASSWORD
        string "WiFi Password"
        default "1234"
        help
            WiFi password
endmenu
menu "Board Configuration"
    config NODE_ID
        string "Unique Node ID"
        default "node_1"
        help
            Unique Node ID

    config NODE_LABELS
        string "Node Labels"
        default ""
        help
            key=value,key2=value2

    config SERVER_NODE
        string "Topology Server Node"
        default ""
        help
            Topology control
endmenu
menu "Benchmark Configuration"
    config BENCHMARK_ENABLED
        bool "Enable Benchmark"
        default n
        help
            Load additional tooling required for benchmarking.
    config BENCHMARK_BREAKDOWN
        bool "Enable breakdown"
        default n
        help
            Enable benchmark breakdown
endmenu
menu "Testbed Configuration"
    config TESTBED_NETWORK_UTILS
        bool "Testbed Network Utils"
        default y
        help
          Enable loggers for values related to networking.
    config TESTBED_NESTED_TIMEKEEPING
      bool "Testbed Nested Timekeeping"
      default n
      help
        Enable nested timekeeping. This enabled the stop_timekeeping_inner method and required the normal stop_timekeeping method to flush the queued inner values.
endmenu
            
```

## sdkconfig.defaults
```kconfig
# msgpack-c requires exceptions
CONFIG_COMPILER_CXX_EXCEPTIONS=y
CONFIG_COMPILER_CXX_EXCEPTIONS_EMG_POOL_SIZE=0
CONFIG_COMPILER_OPTIMIZATION_PERF=y

CONFIG_FREERTOS_HZ=1000

CONFIG_ESP32_DEFAULT_CPU_FREQ_240=y
CONFIG_ESP32_DEFAULT_CPU_FREQ_MHZ=240
CONFIG_ESPTOOLPY_FLASHSIZE_4MB=y
CONFIG_ESPTOOLPY_FLASHSIZE="4MB"

CONFIG_LWIP_USE_ONLY_LWIP_SELECT=y
CONFIG_LWIP_MAX_ACTIVE_TCP=16
CONFIG_LWIP_MAX_LISTENING_TCP=16

CONFIG_PARTITION_TABLE_CUSTOM=y
CONFIG_PARTITION_TABLE_CUSTOM_FILENAME="partitions.csv"
CONFIG_PARTITION_TABLE_FILENAME="partitions.csv"
CONFIG_PARTITION_TABLE_OFFSET=0x8000
CONFIG_PARTITION_TABLE_MD5=y


CONFIG_EINK_SPI_MOSI=23
CONFIG_EINK_SPI_CLK=18
CONFIG_EINK_SPI_CS=5
CONFIG_EINK_DC=17
CONFIG_EINK_RST=16
CONFIG_EINK_BUSY=4
CONFIG_EINK_SPI_CS2=0
CONFIG_EINK_SPI_MISO=0
CONFIG_EINK_SPI_M1_CS=0
CONFIG_EINK_SPI_S1_CS=0
CONFIG_EINK_SPI_M2_CS=0
CONFIG_EINK_SPI_S2_CS=0
CONFIG_EINK_SPI_M1_BUSY=0
CONFIG_EINK_SPI_S1_BUSY=0
CONFIG_EINK_SPI_M2_BUSY=0
CONFIG_EINK_SPI_S2_BUSY=0
CONFIG_EINK_M1S1_DC=0
CONFIG_EINK_M2S2_DC=0
CONFIG_EINK_M1S1_RST=0
CONFIG_EINK_M2S2_RST=0

# WIFI needs to be configured manually
```

## uActor-ESP32/main/Kconfig.projbuild
```kconfig
menu "Wifi Configuration"
    config WIFI_SSID
        string "WiFi SSID"
        default "eduroam"
        help
            SSID
    config WIFI_USE_EDUROAM
        bool "Use eduroam"
        default n
        help
            Use eduroam instead pf WPA personal.
            Uses username + password,
            validatates server using the key in binary folder.
            SSID needs to be set to eduroam.

    config WIFI_USERNAME
        string "Eduroam username"
        default "foobar"
        help
            WiFi WPA enterprise username used in eduroam mode.

    config WIFI_PASSWORD
        string "WiFi Password"
        default "1234"
        help
            WiFi password
endmenu
menu "Board Configuration"
    config USE_MAC_AS_NODE_ID
        bool "Use the MAC address as the node_id"
        default y
    config NODE_ID
        string "Unique Node ID"
        default "node_1"
        depends on !USE_MAC_AS_NODE_ID
    config NODE_LABELS
        string "Node Labels"
        default ""
        help
            key=value,key2=value2

    config SERVER_NODE
        string "Topology Server Node"
        default ""
        help
            Topology control
    config PERSISTENT_PEERS
        string "PERSISTENT PEER"
        default ""
        help
            node_id:node_ip:node_port,node_id..

    config ENABLE_I2C
        bool "Enable I2C Bus"
        default n
    config I2C_SDA_PIN
        int "I2C SDA PIN"
        default 33
        depends on ENABLE_I2C
    config I2C_SCL_PIN
        int "I2C SCL PIN"
        default 32
        depends on ENABLE_I2C
    config ENABLE_SCD30
       bool "Board has SCD30 Sensor"
       default n
       depends on ENABLE_I2C
    config ENABLE_BMP180
       bool "Board has BMP180 Sensor"
       default n
       depends on ENABLE_I2C
    config ENABLE_BME280
       bool "Board has BME280 Sensor"
       default n
       depends on ENABLE_I2C 
    config ENABLE_EPAPER_DISPLAY
       bool "Board has EPaper Display"
       default n
    config ENABLE_BLE_ACTOR
       bool "Enable BLE Actor"
       default y
    config DISABLE_WIFI_PS
       bool "Disable WiFi PS"
       default n
       depends on !ENABLE_BLE_ACTOR
       help
        Power Saving can only be disabled when bluetooth is disabled.
endmenu
menu "Benchmark Configuration"
    config BENCHMARK_ENABLED
        bool "Enable Benchmark"
        default n
        help
            Load additional tooling required for benchmarking.
    config BENCHMARK_BREAKDOWN
        bool "Enable breakdown"
        default n
        help
            Enable benchmark breakdown
endmenu
menu "uActor"
    menu "Optimizations"
        config UACTOR_OPTIMIZATIONS_BLE_FILTER
            bool "Enable Actor-Side BLE packet filtering"
            default y
            help
                Attempts to reduce the publication pressure
        config UACTOR_OPTIMIZATIONS_DIRECT_CODE_STORE
            bool "Direct code store"
            default y
            help
                Let the deployment manager directly interact with the CodeStore.
    endmenu
    config UACTOR_ENABLE_TELEMETRY
       bool "Collect and send telemetry updates"
       default y
    config UACTOR_ENABLE_HEAP_TRACKING
       bool "Component-wise heap-memory tracking"
       default y
    config UACTOR_HIBERNATION
        bool "Enable hibernation"
        default n
endmenu
menu "Testbed Configuration"
    config TESTBED_NETWORK_UTILS
        bool "Testbed Network Utils"
        default y
        help
          Enable loggers for values related to networking.
    config TESTBED_NESTED_TIMEKEEPING
      bool "Testbed Nested Timekeeping"
      default n
      help
        Enable nested timekeeping. This enabled the stop_timekeeping_inner method and required the normal stop_timekeeping method to flush the queued inner values.
endmenu
            
```

## uActor-ESP32/sdkconfig.defaults
```kconfig
# msgpack-c requires exceptions
CONFIG_COMPILER_CXX_EXCEPTIONS=y
CONFIG_COMPILER_CXX_EXCEPTIONS_EMG_POOL_SIZE=0
CONFIG_COMPILER_OPTIMIZATION_PERF=y

CONFIG_FREERTOS_HZ=1000

CONFIG_ESP32_DEFAULT_CPU_FREQ_240=y
CONFIG_ESP32_DEFAULT_CPU_FREQ_MHZ=240
CONFIG_ESPTOOLPY_FLASHSIZE_4MB=y
CONFIG_ESPTOOLPY_FLASHSIZE="4MB"

CONFIG_LWIP_USE_ONLY_LWIP_SELECT=y
CONFIG_LWIP_MAX_ACTIVE_TCP=16
CONFIG_LWIP_MAX_LISTENING_TCP=16

CONFIG_PARTITION_TABLE_CUSTOM=y
CONFIG_PARTITION_TABLE_CUSTOM_FILENAME="partitions.csv"
CONFIG_PARTITION_TABLE_FILENAME="partitions.csv"
CONFIG_PARTITION_TABLE_OFFSET=0x8000
CONFIG_PARTITION_TABLE_MD5=y


CONFIG_EINK_SPI_MOSI=23
CONFIG_EINK_SPI_CLK=18
CONFIG_EINK_SPI_CS=5
CONFIG_EINK_DC=17
CONFIG_EINK_RST=16
CONFIG_EINK_BUSY=4
CONFIG_EINK_SPI_CS2=0
CONFIG_EINK_SPI_MISO=0
CONFIG_EINK_SPI_M1_CS=0
CONFIG_EINK_SPI_S1_CS=0
CONFIG_EINK_SPI_M2_CS=0
CONFIG_EINK_SPI_S2_CS=0
CONFIG_EINK_SPI_M1_BUSY=0
CONFIG_EINK_SPI_S1_BUSY=0
CONFIG_EINK_SPI_M2_BUSY=0
CONFIG_EINK_SPI_S2_BUSY=0
CONFIG_EINK_M1S1_DC=0
CONFIG_EINK_M2S2_DC=0
CONFIG_EINK_M1S1_RST=0
CONFIG_EINK_M2S2_RST=0

CONFIG_BT_ENABLED=y

# Save Space: https://esp32.com/viewtopic.php?f=13&t=3139
CONFIG_BTDM_CTRL_MODE_BLE_ONLY=y
CONFIG_BT_NIMBLE_ENABLED=y

# Save Space: https://esp32.com/viewtopic.php?f=13&t=3139
CONFIG_ESP32_WIFI_STATIC_RX_BUFFER_NUM=3
CONFIG_ESP32_WIFI_DYNAMIC_RX_BUFFER_NUM=6
CONFIG_ESP32_WIFI_DYNAMIC_TX_BUFFER_NUM=6

# We need to find a better way to reduce the IRAM usage, this is temporary:
CONFIG_ESP32_WIFI_IRAM_OPT=n

CONFIG_ENABLE_I2C=y
CONFIG_I2C_SDA_PIN=33
CONFIG_I2C_SCL_PIN=32
CONFIG_ENABLE_SCD30=y
CONFIG_ENABLE_EPAPER_DISPLAY=y

# WIFI needs to be configured manually
```
